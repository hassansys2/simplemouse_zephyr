## CMakeLists.txt
```
#
# Copyright (c) 2019 Nordic Semiconductor ASA
#
# SPDX-License-Identifier: LicenseRef-Nordic-5-Clause
#
cmake_minimum_required(VERSION 3.20.0)

find_package(Zephyr REQUIRED HINTS $ENV{ZEPHYR_BASE})
project(NONE)

FILE(GLOB app_sources src/*.c)
target_sources(app PRIVATE ${app_sources})
```

## prj.conf
```kconfig
# Nordic development kit facilities library
CONFIG_DK_LIBRARY=y
CONFIG_DK_LIBRARY_DYNAMIC_BUTTON_HANDLERS=n

# Build options
CONFIG_DEBUG_OPTIMIZATIONS=y

# Debugging & logging
CONFIG_DEBUG=y
CONFIG_DEBUG_INFO=y
CONFIG_DEBUG_THREAD_INFO=y
CONFIG_RESET_ON_FATAL_ERROR=n
CONFIG_LOG=y
CONFIG_LOG_MODE_MINIMAL=y
CONFIG_ASSERT=y
CONFIG_ASSERT_NO_COND_INFO=y
CONFIG_ASSERT_NO_MSG_INFO=y

# BT general configuration
CONFIG_BT=y
CONFIG_BT_LL_SW_SPLIT=y
CONFIG_BT_DEBUG_LOG=n
CONFIG_BT_KEYS_OVERWRITE_OLDEST=y
CONFIG_BT_SMP_ALLOW_UNAUTH_OVERWRITE=y
CONFIG_BT_GATT_SERVICE_CHANGED=n
CONFIG_BT_LIM_ADV_TIMEOUT=180
CONFIG_BT_SMP=y
CONFIG_BT_L2CAP_TX_BUF_COUNT=2
CONFIG_BT_PERIPHERAL=y
CONFIG_BT_DEVICE_NAME="Simplemouse"
# Mouse appearance = 0x352 (see https://www.bluetooth.com/specifications/assigned-numbers/)
CONFIG_BT_DEVICE_APPEARANCE=962
CONFIG_BT_PERIPHERAL_PREF_MIN_INT=6    
CONFIG_BT_PERIPHERAL_PREF_MAX_INT=18    
CONFIG_BT_PERIPHERAL_PREF_LATENCY=10   
CONFIG_BT_PERIPHERAL_PREF_TIMEOUT=200
CONFIG_BT_GAP_AUTO_UPDATE_CONN_PARAMS=y

# Zephyr BT Services implemented
CONFIG_BT_BAS=y
CONFIG_BT_DIS=y
CONFIG_BT_DIS_PNP=n
CONFIG_BT_DIS_MODEL="Simplemouse"
CONFIG_BT_DIS_MANUF="Novel Bits"
CONFIG_BT_DIS_SERIAL_NUMBER=y
CONFIG_BT_DIS_SERIAL_NUMBER_STR="0xAABBCCDD"

# BT Bonding configuration
CONFIG_BT_SETTINGS=y
CONFIG_BT_BONDABLE=y
CONFIG_BT_SETTINGS_CCC_STORE_ON_WRITE=y
CONFIG_BT_SETTINGS_CCC_LAZY_LOADING=n

# Other needed Zephyr subsys
CONFIG_FLASH=y
CONFIG_FLASH_PAGE_LAYOUT=y
CONFIG_FLASH_MAP=y
CONFIG_NVS=y
CONFIG_SETTINGS=y
```

## src/main.c
```c
#include <zephyr/types.h>
#include <stddef.h>
#include <string.h>
#include <errno.h>
#include <zephyr/sys/printk.h>
#include <zephyr/sys/byteorder.h>
#include <zephyr/kernel.h>
#include <zephyr/drivers/gpio.h>
#include <soc.h>
#include <assert.h>

#include <zephyr/settings/settings.h>

#include <zephyr/bluetooth/bluetooth.h>
#include <zephyr/bluetooth/hci.h>
#include <zephyr/bluetooth/conn.h>
#include <zephyr/bluetooth/uuid.h>
#include <zephyr/bluetooth/gatt.h>

#include <dk_buttons_and_leds.h>

#include "simplemouse_hids.h"

#define DEVICE_NAME     CONFIG_BT_DEVICE_NAME
#define DEVICE_NAME_LEN (sizeof(DEVICE_NAME) - 1)

#define BT_ADV_INT_MIN		48 /* 0.625ms units --> 30ms */
#define BT_ADV_INT_MAX		80 /* 0.625ms units --> 50ms */

#define MOVE_STEP_SIZE		15
#define SCROLL_STEP_SIZE	1

/* Key used for left click, move cursor left, move cursor up or scroll up */
#define KEY_LEFT_UP_MASK   			DK_BTN1_MSK
/* Key used for right click, move cursor right, move cursor down or scroll down */
#define KEY_RIGHT_DOWN_MASK  		DK_BTN2_MSK
/* Key used to move to the next input mode */
#define KEY_INPUT_MODE_PREV_MASK	DK_BTN3_MSK
/* Key used to the previous input mode */
#define KEY_INPUT_MODE_NEXT_MASK	DK_BTN4_MSK

#define KEYS_MONITORING_PERIOD_MS	50

typedef enum
{
    INPUT_MODE_CLICK,
    INPUT_MODE_MOVEX,
    INPUT_MODE_MOVEY,
    INPUT_MODE_SCROLL,

    INPUT_MODE_N

} inputMode_t;

static inputMode_t curr_input_mode;

/* Advertising Data */
static const struct bt_data ad[] = {
    
    /* Appearance */
    BT_DATA_BYTES(BT_DATA_GAP_APPEARANCE,
                  (CONFIG_BT_DEVICE_APPEARANCE >> 0) & 0xff,
                  (CONFIG_BT_DEVICE_APPEARANCE >> 8) & 0xff),

    /* Flags */
    BT_DATA_BYTES(BT_DATA_FLAGS, (BT_LE_AD_LIMITED | BT_LE_AD_NO_BREDR)),

    /* List of UUID16 Services Implemented */
    BT_DATA_BYTES(BT_DATA_UUID16_ALL, 	BT_UUID_16_ENCODE(BT_UUID_HIDS_VAL),
                                        BT_UUID_16_ENCODE(BT_UUID_BAS_VAL),
                                        BT_UUID_16_ENCODE(BT_UUID_DIS_VAL)),
};

/* Scan Response Data */
static const struct bt_data sd[] = {
    BT_DATA(BT_DATA_NAME_COMPLETE, DEVICE_NAME, DEVICE_NAME_LEN),
};

static struct k_work adv_work;

static bt_addr_le_t bonded_addr;
static bool bonded_addr_present;

static bool dir_adv_timeout;
static bool is_connected;
static int64_t last_advertising_start_ms;

static void s_bonded_addr_cache(const struct bt_bond_info *info, void *user_data)
{
    memcpy(&bonded_addr, &info->addr, sizeof(bt_addr_le_t));
    bonded_addr_present = true;
}

static void s_advertising_start(void)
{
    /* NOTE: only one paired device is supported, so the function passed as argument is invoked once at most */
    bt_foreach_bond(BT_ID_DEFAULT, s_bonded_addr_cache, NULL);
    k_work_submit(&adv_work);
}

static void s_advertising_exec(void)
{
    int err = 0;
    struct bt_le_adv_param adv_param;

    /* Directed advertising if bonding is present and we did not already timed out */
    if ((bonded_addr_present) && (!dir_adv_timeout))
    {
        char addr_buf[BT_ADDR_LE_STR_LEN];

        adv_param = *BT_LE_ADV_CONN_DIR(&bonded_addr);
        adv_param.options |= BT_LE_ADV_OPT_DIR_ADDR_RPA;

        err = bt_le_adv_start(&adv_param, NULL, 0, NULL, 0);
        if (err)
        {
            printk("Directed advertising failed to start (err %d)\n", err);
            return;
        }

        bt_addr_le_to_str(&bonded_addr, addr_buf, BT_ADDR_LE_STR_LEN);
        printk("Direct advertising to %s started\n", addr_buf);
    }
    /* Regular advertising if no bonding is present */
    else
    {
        adv_param = *BT_LE_ADV_CONN;
        adv_param.interval_min = BT_ADV_INT_MIN;
        adv_param.interval_max = BT_ADV_INT_MAX;
        adv_param.options |= BT_LE_ADV_OPT_ONE_TIME | BT_LE_ADV_OPT_SCANNABLE;

        err = bt_le_adv_start(&adv_param, ad, ARRAY_SIZE(ad), sd, ARRAY_SIZE(sd));
        if (err)
        {
            printk("Advertising failed to start (err %d)\n", err);
            return;
        }

        printk("Regular advertising started\n");
    }

    if(err == 0)
    {
        /* Cache last start of advertising */
        last_advertising_start_ms = k_uptime_get();
    }
}

static void s_advertising_process(struct k_work *work)
{
    s_advertising_exec();
}

static void s_connected(struct bt_conn *conn, uint8_t err)
{
    char addr[BT_ADDR_LE_STR_LEN];

    bt_addr_le_to_str(bt_conn_get_dst(conn), addr, sizeof(addr));

    if (err) 
    {
        if (err == BT_HCI_ERR_ADV_TIMEOUT)
        {
            printk("Direct advertising to %s timed out\n", addr);
            dir_adv_timeout = true;
            k_work_submit(&adv_work);
        }
        else
        {
            printk("Failed to connect to %s (%u)\n", addr, err);
        }

        return;
    }

    printk("Connected %s\n", addr);

    is_connected = true;
    dir_adv_timeout = false;
    last_advertising_start_ms = 0;

    /* Inform HID Service */
    simplemouse_hids_connected(conn);
}

static void s_disconnected(struct bt_conn *conn, uint8_t reason)
{
    char addr[BT_ADDR_LE_STR_LEN];

    bt_addr_le_to_str(bt_conn_get_dst(conn), addr, sizeof(addr));

    printk("Disconnected from %s (reason %u)\n", addr, reason);

    /* Inform HID Service */
    simplemouse_hids_disconnected();

    is_connected = false;

    /* Re-start advertising */
    s_advertising_start();
}

static void s_security_changed(struct bt_conn *conn, bt_security_t level,
                 enum bt_security_err err)
{
    char addr[BT_ADDR_LE_STR_LEN];

    bt_addr_le_to_str(bt_conn_get_dst(conn), addr, sizeof(addr));

    if (!err)
    {
        printk("Security changed: %s level %u\n", addr, level);
    }
    else
    {
        printk("Security failed: %s level %u err %d\n", addr, level, err);
    }
}

static void s_conn_params_updated(struct bt_conn *conn, uint16_t interval,
                              uint16_t latency, uint16_t timeout)
{
    struct bt_conn_info info;
    bt_conn_get_info(conn, &info);

    printk("Conn params updated, interval: %u, latency: %u, timeout: %u\n",
            info.le.interval, info.le.latency, info.le.timeout);

}

BT_CONN_CB_DEFINE(conn_callbacks) = {
    .connected = s_connected,
    .disconnected = s_disconnected,
    .security_changed = s_security_changed,
    .le_param_updated = s_conn_params_updated
};

static void s_pairing_complete(struct bt_conn *conn, bool bonded)
{
    char addr[BT_ADDR_LE_STR_LEN];
    bt_addr_le_to_str(bt_conn_get_dst(conn), addr, sizeof(addr));

    printk("Pairing completed: %s, bonded: %d\n", addr, bonded);
}

static void s_pairing_failed(struct bt_conn *conn, enum bt_security_err reason)
{
    char addr[BT_ADDR_LE_STR_LEN];
    bt_addr_le_to_str(bt_conn_get_dst(conn), addr, sizeof(addr));

    printk("Pairing failed conn: %s, reason %d\n", addr, reason);
}

static struct bt_conn_auth_info_cb conn_auth_info_callbacks = {
    .pairing_complete = s_pairing_complete,
    .pairing_failed = s_pairing_failed
};

static void s_send_mouse_notification(uint8_t buttons_bitmask, int16_t move_x, int16_t move_y, int8_t scroll_v)
{
    simplemouse_hids_prot_mode_t currProtMode = simplemouse_hids_get_prot_mode();

    if(simplemouse_hids_is_mouse_report_writable())
    {
        if (SIMPLEMOUSE_HIDS_PM_REPORT == currProtMode)
        {
            simplemouse_hids_report_mouse_t mse_report =
            {
                .buttons_bitmask = buttons_bitmask,
                .move_x_lsb = (uint8_t)move_x,
                .move_x_msb = (uint8_t)(move_x >> 8) & 0xFF,
                .move_y_lsb = (uint8_t)move_y,
                .move_y_msb = (uint8_t)(move_y >> 8) & 0xFF,
                .scroll_v = scroll_v
            };

            simplemouse_hids_mouse_notify_input(&mse_report, sizeof(simplemouse_hids_report_mouse_t));
        }
        else if (SIMPLEMOUSE_HIDS_PM_BOOT == currProtMode)
        {
            simplemouse_hids_report_mouse_boot_t mse_boot_report =
            {
                .buttons_bitmask = buttons_bitmask,
                .move_x = move_x, /* implicit cast to 8 bits */
                .move_y = move_y, /* implicit cast to 8 bits */
                .scroll_v = scroll_v
            };

            simplemouse_hids_mouse_notify_boot(&mse_boot_report, sizeof(simplemouse_hids_report_mouse_boot_t));
        }
    }
}

static void s_update_input_modes(uint32_t buttons_set)
{
    inputMode_t new_input_mode = curr_input_mode;

    if (buttons_set & KEY_INPUT_MODE_NEXT_MASK)
    {
        /* Go to the next */
        new_input_mode = (curr_input_mode + 1) % INPUT_MODE_N;
    }
    else if (buttons_set & KEY_INPUT_MODE_PREV_MASK)
    {
        /* Go to previous */
        if(curr_input_mode == 0)
        {
            new_input_mode = INPUT_MODE_N - 1;
        }
        else
        {
            new_input_mode = curr_input_mode - 1;
        }
    }

    if (new_input_mode != curr_input_mode)
    {
        curr_input_mode = new_input_mode;
        dk_set_leds_state(BIT(curr_input_mode), DK_ALL_LEDS_MSK);
        printk("New Input Mode = %d\n", curr_input_mode);
    }
}

static void s_take_action(uint32_t button_state, uint32_t has_changed)
{
    if (INPUT_MODE_CLICK == curr_input_mode)
    {
        /* Proceed notifying the new button state only if one of the 2 action buttons did change */
        if((has_changed & KEY_LEFT_UP_MASK) ||
           (has_changed & KEY_RIGHT_DOWN_MASK))
        {
            s_send_mouse_notification(button_state & (KEY_LEFT_UP_MASK | KEY_RIGHT_DOWN_MASK), 0, 0, 0);
        }
    }
    else if (INPUT_MODE_MOVEX == curr_input_mode)
    {
        if(button_state & KEY_LEFT_UP_MASK)
        {
            s_send_mouse_notification(0, -(MOVE_STEP_SIZE), 0, 0);
        }
        else if(button_state & KEY_RIGHT_DOWN_MASK)
        {
            s_send_mouse_notification(0, MOVE_STEP_SIZE, 0, 0);
        }
    }
    else if(INPUT_MODE_MOVEY == curr_input_mode)
    {
        if(button_state & KEY_LEFT_UP_MASK)
        {
            s_send_mouse_notification(0, 0, -(MOVE_STEP_SIZE), 0);
        }
        else if(button_state & KEY_RIGHT_DOWN_MASK)
        {
            s_send_mouse_notification(0, 0, MOVE_STEP_SIZE, 0);
        }
    }
    else if(INPUT_MODE_SCROLL == curr_input_mode)
    {
        if(button_state & KEY_LEFT_UP_MASK)
        {
            s_send_mouse_notification(0, 0, 0, SCROLL_STEP_SIZE);
        }
        else if(button_state & KEY_RIGHT_DOWN_MASK)
        {
            s_send_mouse_notification(0, 0, 0, -(SCROLL_STEP_SIZE));
        }
    }
}

static void s_init_dk_buttons_and_leds(void)
{
    int err;

    err = dk_buttons_init(NULL);
    __ASSERT_NO_MSG(err == 0);

    err = dk_leds_init();
    __ASSERT_NO_MSG(err == 0);
}

void main(void)
{
    int err;

    printk("Starting Simplemouse application\n");

    err = bt_conn_auth_info_cb_register(&conn_auth_info_callbacks);
    if (err)
    {
        printk("Failed to register authorization info callbacks.\n");
        return;
    }

    err = bt_enable(NULL);
    if (err)
    {
        printk("Bluetooth init failed (err %d)\n", err);
        return;
    }

    printk("Bluetooth initialized\n");

    if (IS_ENABLED(CONFIG_SETTINGS))
    {
        settings_load();
    }

    /* Init workqueue item to help during advertising */
    k_work_init(&adv_work, s_advertising_process);

    /* Immediately request advertising to start */
    s_advertising_start();

    /* Init buttons and leds for the board */
    s_init_dk_buttons_and_leds();
    dk_set_leds_state(BIT(curr_input_mode), DK_ALL_LEDS_MSK);
    printk("Input Mode initialized = %d\n", curr_input_mode);

    uint32_t buttons_state;
    uint32_t buttons_changed;
    uint32_t buttons_just_set;

    /* Main loop */
    while (1)
    {
        /* If we are not connected, check the advertising timeout as termination condition */
        if(!is_connected)
        {
            int64_t ref_time = last_advertising_start_ms;

            if ((ref_time != 0) &&
                k_uptime_delta(&ref_time) >= (CONFIG_BT_LIM_ADV_TIMEOUT * 1000))
            {
                printk("Move to IDLE, reset the board to restart the application...\n");
                /* Switch off all the LEDs */
                dk_set_leds_state(0, DK_ALL_LEDS_MSK);
                break;
            }
        }	

        /* Get current buttons state */
        dk_read_buttons(&buttons_state, &buttons_changed);
        buttons_just_set = buttons_state & buttons_changed;

        /* Check input mode buttons and update state, if needed */
        s_update_input_modes(buttons_just_set);

        /* Do whatever is needed, depending on current input mode */
        s_take_action(buttons_state, buttons_changed);
        
        /* Sleep */
        k_sleep(K_MSEC(KEYS_MONITORING_PERIOD_MS));
    }
}
```

## src/simplemouse_hids.c
```c
#include <zephyr/types.h>
#include <stddef.h>
#include <string.h>
#include <errno.h>
#include <sys/byteorder.h>
#include <zephyr.h>

#include <bluetooth/bluetooth.h>
#include <bluetooth/hci.h>
#include <bluetooth/conn.h>
#include <bluetooth/uuid.h>
#include <bluetooth/gatt.h>

#include "simplemouse_hids.h"

#define REPORT_MOUSE_SIZE           sizeof(simplemouse_hids_report_mouse_t)
#define BOOT_REPORT_MOUSE_SIZE      sizeof(simplemouse_hids_report_mouse_boot_t)

enum
{
    HIDS_REPORT_ID_MOUSE          =  0x01,
};
typedef uint8_t hids_report_id_t;

/* HIDS Info flags */
enum
{
    HIDS_REMOTE_WAKE            = BIT(0),
    HIDS_NORMALLY_CONNECTABLE   = BIT(1),
};

/* Control Point possible values */
enum
{
    HIDS_CONTROL_POINT_SUSPEND      = 0x00,
    HIDS_CONTROL_POINT_EXIT_SUSPEND = 0x01,

    HIDS_CONTROL_POINT_N
};
typedef uint8_t hids_ctrl_point_t;

/* HID Information Characteristic value */
typedef struct
{
    uint16_t version;   /* version number of base USB HID Specification */
    uint8_t code;       /* country HID Device hardware is localized for. */
    uint8_t flags;

} __packed hids_info_t;

/* Type of reports */
enum
{
    HIDS_REPORT_INPUT   = 0x01,
    HIDS_REPORT_OUTPUT  = 0x02,
    HIDS_REPORT_FEATURE = 0x03,
};
typedef uint8_t hids_report_type_t;

/* HID Report Characteristic Descriptor */
typedef struct
{
    uint8_t id;                 /* report id */
    hids_report_type_t type;    /* report type */

} __packed hids_report_desc_t;

typedef struct
{
    uint8_t* const report_ref;
    uint8_t report_len;

} hids_report_info_t;

static const hids_info_t hids_info =
{
    .version = 0x0101,
    .code = 0x00,
    .flags = HIDS_NORMALLY_CONNECTABLE,
};

/* Reports descriptors (read-only) */
static const hids_report_desc_t mse_input_desc =
{
    .id = HIDS_REPORT_ID_MOUSE,
    .type = HIDS_REPORT_INPUT,
};

/* Module working data */
static struct bt_conn *active_conn;

/* Characteristics and descriptors cached values */
static bool mse_input_rep_notif_enabled;
static bool mse_boot_input_rep_notif_enabled;

static hids_ctrl_point_t ctrl_point;
static simplemouse_hids_prot_mode_t prot_mode;
static uint8_t mse_input_report[REPORT_MOUSE_SIZE];
static uint8_t mse_boot_input_report[BOOT_REPORT_MOUSE_SIZE];

/* Report map */
static const uint8_t report_map[] =
{
    /* MOUSE INPUT REPORT MAP */
    0x05, 0x01,                 // Usage Page (Generic Desktop Ctrls)
    0x09, 0x02,                 // Usage (Mouse)
    0xA1, 0x01,                 // Collection (Application)
    0x85, HIDS_REPORT_ID_MOUSE, //   Report ID (1)
    0x09, 0x01,                 //   Usage (Pointer)
    0xA1, 0x00,                 //   Collection (Physical)
    0x95, 0x02,                 //     Report Count (2)
    0x75, 0x01,                 //     Report Size (1)
    0x15, 0x00,                 //     Logical Minimum (0)
    0x25, 0x01,                 //     Logical Maximum (1)
    0x05, 0x09,                 //     Usage Page (Button)
    0x19, 0x01,                 //     Usage Minimum (0x01)
    0x29, 0x02,                 //     Usage Maximum (0x02)
    0x81, 0x02,                 //     Input (Data,Var,Abs,No Wrap,Linear,Preferred State,No Null Position)
    0x95, 0x01,                 //     Report Count (1)
    0x75, 0x06,                 //     Report Size (6)
    0x81, 0x03,                 //     Input (Cnst, Var, Abs)
    0x05, 0x01,                 //     Usage Page (Generic Desktop Ctrls)
    0x16, 0x00, 0x80,           //     Logical Minimum (-32768)
    0x26, 0xFF, 0x7F,           //     Logical Maximum (32767)
    0x75, 0x10,                 //     Report Size (16)
    0x95, 0x02,                 //     Report Count (2)
    0x09, 0x30,                 //     Usage (X)
    0x09, 0x31,                 //     Usage (Y)
    0x81, 0x06,                 //     Input (Data,Var,Rel,No Wrap,Linear,Preferred State,No Null Position)
    0x15, 0x81,                 //     Logical Minimum (-127)
    0x25, 0x7F,                 //     Logical Maximum (127)
    0x75, 0x08,                 //     Report Size (8)
    0x95, 0x01,                 //     Report Count (1)
    0x09, 0x38,                 //     Usage (Wheel)
    0x81, 0x06,                 //     Input (Data,Var,Rel,No Wrap,Linear,Preferred State,No Null Position)
    0xC0,                       //   End Collection
    0xC0,                       // End Collection
};

static const hids_report_info_t mse_input_rep_info =
{
    .report_ref = mse_input_report,
    .report_len = sizeof(mse_input_report)
};

static const hids_report_info_t mse_boot_input_rep_info =
{
    .report_ref = mse_boot_input_report,
    .report_len = sizeof(mse_boot_input_report)
};

/*
** --------------------------------------------------------
** Private Functions
** --------------------------------------------------------
*/

static ssize_t s_read_info( struct bt_conn *conn,
                            const struct bt_gatt_attr *attr, void *buf,
                            uint16_t len, uint16_t offset)
{
    return bt_gatt_attr_read(conn, attr, buf, len, offset, &hids_info, sizeof(hids_info_t));
}

static ssize_t s_read_report_map(   struct bt_conn *conn,
                                    const struct bt_gatt_attr *attr, void *buf,
                                    uint16_t len, uint16_t offset)
{
    return bt_gatt_attr_read(conn, attr, buf, len, offset, report_map, sizeof(report_map));
}

static ssize_t s_read_report(   struct bt_conn *conn,
                                const struct bt_gatt_attr *attr, void *buf,
                                uint16_t len, uint16_t offset)
{
    const hids_report_info_t* rep_info_ref = (const hids_report_info_t*) attr->user_data;
    return bt_gatt_attr_read(conn, attr, buf, len, offset, rep_info_ref->report_ref, rep_info_ref->report_len);
}

static ssize_t s_read_prot_mode(struct bt_conn *conn,
                                const struct bt_gatt_attr *attr, void *buf,
                                uint16_t len, uint16_t offset)
{
    return bt_gatt_attr_read(conn, attr, buf, len, offset, &prot_mode, sizeof(prot_mode));
}

static ssize_t s_read_report_desc(  struct bt_conn *conn,
                                    const struct bt_gatt_attr *attr, void *buf,
                                    uint16_t len, uint16_t offset)
{
    return bt_gatt_attr_read(conn, attr, buf, len, offset, attr->user_data, sizeof(hids_report_desc_t));
}

static void s_mse_boot_input_rep_ccc_changed(const struct bt_gatt_attr *attr, uint16_t value)
{
    mse_boot_input_rep_notif_enabled = (value == BT_GATT_CCC_NOTIFY) ? true : false;
}

static void s_mse_input_rep_ccc_changed(const struct bt_gatt_attr *attr, uint16_t value)
{
    mse_input_rep_notif_enabled = (value == BT_GATT_CCC_NOTIFY) ? true : false;
}

static ssize_t s_write_ctrl_point(  struct bt_conn *conn,
                                    const struct bt_gatt_attr *attr,
                                    const void *buf, uint16_t len, uint16_t offset,
                                    uint8_t flags)
{
    uint8_t* const ctrl_point_ref = (uint8_t* const)&ctrl_point;
    const uint8_t new_ctrl_pnt = *((const uint8_t *) buf);

    /* Validate flags */
    if (!(flags & BT_GATT_WRITE_FLAG_CMD))
    {
        /* Only write without response accepted */
        return BT_GATT_ERR(BT_ATT_ERR_WRITE_REQ_REJECTED);
    }

    /* Validate length */
    if ((offset + len) > sizeof(ctrl_point))
    {
        return BT_GATT_ERR(BT_ATT_ERR_INVALID_OFFSET);
    }

    /* Validate value */
    if (new_ctrl_pnt >= HIDS_CONTROL_POINT_N)
    {
        return BT_GATT_ERR(BT_ATT_ERR_NOT_SUPPORTED);
    }

    memcpy(ctrl_point_ref + offset, buf, len);

    return len;
}

static ssize_t s_write_prot_mode(   struct bt_conn *conn,
                                    const struct bt_gatt_attr *attr,
                                    const void *buf, uint16_t len, uint16_t offset,
                                    uint8_t flags)
{
    uint8_t* const prot_mode_ref = (uint8_t* const) &prot_mode;
    const simplemouse_hids_prot_mode_t newPm = *((const simplemouse_hids_prot_mode_t *) buf);

    /* Validate flags */
    if (!(flags & BT_GATT_WRITE_FLAG_CMD))
    {
        /* Only write without response accepted */
        return BT_GATT_ERR(BT_ATT_ERR_WRITE_REQ_REJECTED);
    }

    /* Validate length */
    if ((offset + len) > sizeof(prot_mode))
    {
        return BT_GATT_ERR(BT_ATT_ERR_INVALID_OFFSET);
    }

    /* Validate value received */
    if (newPm >= SIMPLEMOUSE_HIDS_PM_N)
    {
        return BT_GATT_ERR(BT_ATT_ERR_NOT_SUPPORTED);
    }

    memcpy(prot_mode_ref + offset, buf, len);

    return len;
}

/* HID Service Definition */
BT_GATT_SERVICE_DEFINE(simplemouse_svc,

    BT_GATT_PRIMARY_SERVICE(BT_UUID_HIDS),

    /* Information Characteristic */
    BT_GATT_CHARACTERISTIC( BT_UUID_HIDS_INFO,
                            BT_GATT_CHRC_READ,
                            BT_GATT_PERM_READ_ENCRYPT,
                            s_read_info, NULL, NULL),

    /* Control Point Characteristic */
    BT_GATT_CHARACTERISTIC( BT_UUID_HIDS_CTRL_POINT,
                            BT_GATT_CHRC_WRITE_WITHOUT_RESP,
                            BT_GATT_PERM_WRITE_ENCRYPT,
                            NULL, s_write_ctrl_point, NULL),

    /* Report Map Characteristic */
    BT_GATT_CHARACTERISTIC( BT_UUID_HIDS_REPORT_MAP,
                            BT_GATT_CHRC_READ,
                            BT_GATT_PERM_READ_ENCRYPT,
                            s_read_report_map, NULL, NULL),

    /* Protocol Mode Characteristic */
    BT_GATT_CHARACTERISTIC( BT_UUID_HIDS_PROTOCOL_MODE,
                            BT_GATT_CHRC_READ |
                            BT_GATT_CHRC_WRITE_WITHOUT_RESP,
                            BT_GATT_PERM_READ_ENCRYPT |
                            BT_GATT_PERM_WRITE_ENCRYPT,
                            s_read_prot_mode, s_write_prot_mode, NULL),

    /* Boot Mouse Input Report Characteristic */
    BT_GATT_CHARACTERISTIC( BT_UUID_HIDS_BOOT_MOUSE_IN_REPORT,
                            BT_GATT_CHRC_READ | BT_GATT_CHRC_NOTIFY,
                            BT_GATT_PERM_READ_ENCRYPT,
                            s_read_report, NULL,
                            (hids_report_info_t*)&mse_boot_input_rep_info),
    BT_GATT_CCC(s_mse_boot_input_rep_ccc_changed,
                BT_GATT_PERM_READ | BT_GATT_PERM_WRITE_ENCRYPT),

    /* Mouse Input Report Characteristic (+ descriptor) */
    BT_GATT_CHARACTERISTIC( BT_UUID_HIDS_REPORT,
                            BT_GATT_CHRC_READ | BT_GATT_CHRC_NOTIFY,
                            BT_GATT_PERM_READ_ENCRYPT,
                            s_read_report, NULL,
                           (hids_report_info_t*)&mse_input_rep_info),
    BT_GATT_CCC(s_mse_input_rep_ccc_changed,
                BT_GATT_PERM_READ | BT_GATT_PERM_WRITE_ENCRYPT),
    BT_GATT_DESCRIPTOR( BT_UUID_HIDS_REPORT_REF,
                        BT_GATT_PERM_READ,
                        s_read_report_desc, NULL,
                        (hids_report_desc_t*) &mse_input_desc),
);

void simplemouse_hids_connected(struct bt_conn *conn)
{
    active_conn = conn;
    
    /* Set Protocol Mode back to default (Report), as dictated by the spec */
    prot_mode = SIMPLEMOUSE_HIDS_PM_REPORT;
}

void simplemouse_hids_disconnected(void)
{
    active_conn = NULL;
}

simplemouse_hids_prot_mode_t simplemouse_hids_get_prot_mode(void)
{
    return prot_mode;
}

bool simplemouse_hids_is_mouse_report_writable(void)
{
    /* Return false if connection is still not encrypted */
    if((active_conn == NULL) || (bt_conn_get_security(active_conn) < BT_SECURITY_L2))
    {
        return false;
    }

    if(prot_mode == SIMPLEMOUSE_HIDS_PM_BOOT)
    {
        return mse_boot_input_rep_notif_enabled;
    }
    else
    {
        return mse_input_rep_notif_enabled;
    }
}

void simplemouse_hids_mouse_notify_input(const void* data, uint8_t dataLen)
{
    __ASSERT_NO_MSG(dataLen == sizeof(mse_input_report));
    __ASSERT_NO_MSG(mse_input_rep_notif_enabled);
    __ASSERT_NO_MSG(bt_conn_get_security(active_conn) >= BT_SECURITY_L2);

    int err;
    struct bt_gatt_notify_params params = {0};

    memcpy(mse_input_report, data, dataLen);

    params.uuid = BT_UUID_HIDS_REPORT;
    params.data = data;
    params.len = dataLen;
    params.func = NULL;
    err = bt_gatt_notify_cb(active_conn, &params);
}

void simplemouse_hids_mouse_notify_boot(const void* data, uint8_t dataLen)
{
    __ASSERT_NO_MSG(dataLen == sizeof(mse_boot_input_report));
    __ASSERT_NO_MSG(mse_boot_input_rep_notif_enabled);
    __ASSERT_NO_MSG(bt_conn_get_security(active_conn) >= BT_SECURITY_L2);

    int err;
    struct bt_gatt_notify_params params = {0};

    memcpy(mse_boot_input_report, data, dataLen);

    params.uuid = BT_UUID_HIDS_BOOT_MOUSE_IN_REPORT;
    params.data = data;
    params.len = dataLen;
    params.func = NULL;
    err = bt_gatt_notify_cb(active_conn, &params);
}
```

## src/simplemouse_hids.h
```c
#ifndef SIMPLEMOUSE_HIDS_H
#define SIMPLEMOUSE_HIDS_H

#ifdef __cplusplus
extern "C" {
#endif

#include <bluetooth/conn.h>

#include "simplemouse_hids_def.h"

void simplemouse_hids_connected(struct bt_conn *conn);
void simplemouse_hids_disconnected(void);

simplemouse_hids_prot_mode_t simplemouse_hids_get_prot_mode(void);

bool simplemouse_hids_is_mouse_report_writable(void);
void simplemouse_hids_mouse_notify_input(const void* data, uint8_t dataLen);
void simplemouse_hids_mouse_notify_boot(const void* data, uint8_t dataLen);

#ifdef __cplusplus
}
#endif

#endif /* SIMPLEMOUSE_HIDS_H */
```

## src/simplemouse_hids_def.h
```c
#ifndef SIMPLEMOUSE_HIDS_DEF_H
#define SIMPLEMOUSE_HIDS_DEF_H

#ifdef __cplusplus
extern "C" {
#endif


#include <stdint.h>

/* Protocol Mode */
enum
{
    SIMPLEMOUSE_HIDS_PM_BOOT    = 0x00,
    SIMPLEMOUSE_HIDS_PM_REPORT  = 0x01,

    SIMPLEMOUSE_HIDS_PM_N  
};
typedef uint8_t simplemouse_hids_prot_mode_t;

/*
** --------------------------------------------------------
** Mouse reports descriptor (custom and boot).
** NOTE: these are the packed structs being sent over-the-air
** --------------------------------------------------------
*/

/* Mouse Input Report format is defined according to the Report Map characteristic:
 *  8 bits - pressed buttons bitmask (2 LSB used + 6 MSB padding)
 *  16 bits - x movement
 *  16 bits - y movement
 *  8 bits - vertical wheel rotation (device specific)
 */
typedef struct
{
    uint8_t         buttons_bitmask;
    uint8_t         move_x_lsb;
    uint8_t         move_x_msb;
    uint8_t         move_y_lsb;
    uint8_t         move_y_msb;
    uint8_t         scroll_v;
} __packed simplemouse_hids_report_mouse_t;

/* Boot Report is fixed to 4 bytes and CANNOT be modified:
 *  8 bits - pressed buttons bitmask
 *  8 bits - x movement
 *  8 bits - y movement
 *  8 bits - vertical wheel rotation (device specific)
 */
typedef struct
{
    uint8_t         buttons_bitmask;
    int8_t          move_x;
    int8_t          move_y;
    int8_t          scroll_v;

} __packed simplemouse_hids_report_mouse_boot_t;


#ifdef __cplusplus
}
#endif

#endif /* SIMPLEMOUSE_HIDS_DEF_H */
```
